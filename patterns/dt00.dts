/dts-v1/;

/ {
    node1 {
        a-string-property = "A string";
        b-string-property = "B string";
        c-string-property = "C string";
        d-string-property = "D string";
    };
    node2 {
        e-string-property = "E string";
        empty;
    };
};
